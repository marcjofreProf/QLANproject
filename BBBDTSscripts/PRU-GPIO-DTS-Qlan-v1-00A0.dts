
// This DTS overlay sets up input and output pin for use by  
 // PRU1 via its Enhanced GPIO mode, which will let us access those pins  
 // by writing to R30 bits or reading from R31 bits.  
   
 // Save this file wherever you want (but I recommend /lib/firmware), as  
 // "PRU-GPIO-DTS-Qlan-v1-00A0.dts".
   
 // Compile with:
 // dtc -O dtb -I dts -o /lib/firmware/PRU-GPIO-DTS-Qlan-v1-00A0.dtbo -b 0 -@ PRU-GPIO-DTS-Qlan-v1-00A0.dts  
   
 // You'll have to reboot, after which you can do this as root to activate it:  
 // echo PRU-GPIO-DTS-Qlan-v1 > /sys/devices/bone_capemgr.?/slots  
 
 /dts-v1/;  
 /plugin/;  

 
 / {  
   // This determines which boards can use this DTS overlay  
   compatible = "ti,beaglebone", "ti,beaglebone-green", "ti,beaglebone-black";  
   
   // I think part-number is supposed to correspond with the filename,  
   // so we'd save this as "PRU-GPIO-DTS-Qlan-v1-00A0.dts".  
   part-number = "PRU-GPIO-DTS-Qlan-v1";  
   
   // This always seems to be 00A0, and all the .dtbo files in /lib/firmware  
   // seem to be named foo-00A0.dtbo, but then are loaded without that suffix.  So
   // for foo-00A0.dtbo we'd do 'echo foo > /sys/devices/bone_capemgr.?/slots'
   version = "00A0";
   
   // List the pins and resources we'll be using. This table:  
   // http://elinux.org/Ti_AM33XX_PRUSSv2#Beaglebone_PRU_connections_and_modes  
   // shows which pins can be used with PRU0 and PRU1 for input and output via  
   // registers R31 and R30.  
   // Our output pin, P8_27, 28, 29, 30, 39, 40, 41, 42, 43, 44, 45, 46, corresponds to PRU 1
   // Our input pin, P8_15, P8_16, P8_11, P8_12, P9_25, P9_41, P9_27, P9_42, P9_28, P9_29, P9_30 and P_31, corresponds to PRU 0
   //  
   // Beware: Many other PRU EGP pins are reserved by HDMI or onboard flash, which  
   // would need to be disabled first by editing uEnv.txt and rebooting.  
   
   exclusive-use = "P8.15","P8.16", "P8.11", "P8.12","P9.25", "P9.41", "P9.27", "P9.42", "P9.28", "P9.29", "P9.30", "P9.31", "P8.45", "P8.46", "P8.43", "P8.44", "P8.41", "P8.42", "P8.39", "P8.40", "P8.27", "P8.29", "P8.28", "P8.30", "pru0", "pru1";  
  
//fragment@0{
//  target = <&ocp>; 
//__overlay__{   
//gpio_pins: pinmux_gpio_pins {
//	// The GPIO pins
//	pinctrl-single,pins = <
//		 
//		>;
//		};
//	};
// };
 
 fragment@0 {  
    target = <&am33xx_pinmux>;  
    __overlay__ {  
      example_pins: pinmux_pru_pru_pins {  
       // https://elinux.org/Ti_AM33XX_PRUSSv2#Beaglebone_PRU_connections_and_modes
       // The offset and mode for pins P8_11 and P8_16 also come from the table linked above.
       // 	        Bits 0..2 are the multiplexer mode
       //		Bit 3 enables (0) or disables (1) the internal pullup/pulldown resistor
       //		Bit 4 is 0 for pulldown, 1 for pullup
       //		Bit 5 is 0 to disable input, 1 to enable input.
       //		Bit 6 is 1 if you want slow rise/fall times (for long i2c buses)
        
       pinctrl-single,pins = <          
         0x19C 0x26      // Mode 6 input pull-down
         0x194 0x26      // Mode 6 input pull-down
         0x198 0x26      // Mode 6 input pull-down
         0x190 0x26      // Mode 6 input pull-down
         0x1A4 0x26      // Mode 6 input pull-down
         0x1AC 0x26      // Mode 6 input pull-down
         0x038 0x26      // Mode 6 input pull-down
         0x03C 0x26      // Mode 6 input pull-down
         0x1A0 0x26      // Mode 6 input pull-down
         0x1A8 0x26      // Mode 6 input pull-down
         0x034 0x26      // Mode 6 input pull-down
         0x030 0x26      // Mode 6 input pull-down
         
         0x0E0 0x0D	     // Mode 5 output non-pull
         0x0E4 0x0D	     // Mode 5 output non-pull
         0x0E8 0x0D	     // Mode 5 output non-pull
         0x0EC 0x0D	     // Mode 5 output non-pull
         0x0B8 0x0D	     // Mode 5 output non-pull
         0x0BC 0x0D	     // Mode 5 output non-pull
         0x0B0 0x0D	     // Mode 5 output non-pull
         0x0B4 0x0D	     // Mode 5 output non-pull
         0x0A8 0x0D	     // Mode 5 output non-pull
         0x0AC 0x0D	     // Mode 5 output non-pull
         0x0A0 0x0D	     // Mode 5 output non-pull
	       0x0A4 0x0D	     // Mode 5 output non-pull
       >;  
      };  
    };  
   }; 
  
  // Free up the pins used by the cape from the pinmux helpers.
//	fragment@2 {
//		target = <&ocp>;
//		__overlay__ {
//			//P8_45_pinmux { status = "disabled"; };	/* lcd_data0 */
//			//P8_46_pinmux { status = "disabled"; };	/* lcd_data1 */
//			//P8_43_pinmux { status = "disabled"; };	/* lcd_data2 */
//			//P8_44_pinmux { status = "disabled"; };	/* lcd_data3 */
//			//P8_41_pinmux { status = "disabled"; };	/* lcd_data4 */
//			//P8_42_pinmux { status = "disabled"; };	/* lcd_data5 */
//			//P8_39_pinmux { status = "disabled"; };	/* lcd_data6 */
//			//P8_40_pinmux { status = "disabled"; };	/* lcd_data7 */
//			P8_37_pinmux { status = "disabled"; };	/* lcd_data8 */
//			P8_38_pinmux { status = "disabled"; };	/* lcd_data9 */
//			P8_36_pinmux { status = "disabled"; };	/* lcd_data10 */
//			P8_34_pinmux { status = "disabled"; };	/* lcd_data11 */
//			P8_35_pinmux { status = "disabled"; };	/* lcd_data12 */
//			P8_33_pinmux { status = "disabled"; };	/* lcd_data13 */
//			P8_31_pinmux { status = "disabled"; };	/* lcd_data14 */
//			P8_32_pinmux { status = "disabled"; };	/* lcd_data15 */
//			//P8_27_pinmux { status = "disabled"; };	/* lcd_vsync */
//			//P8_29_pinmux { status = "disabled"; };	/* lcd_hsync */
//			//P8_28_pinmux { status = "disabled"; };	/* lcd_pclk */
//			//P8_30_pinmux { status = "disabled"; };	/* lcd_ac_bias_en */
//		};
//	};
   
   // This enables the PRU and assigns the GPIO pins to it for use in EGP mode.  
//   fragment@3 {  
//   target = <&ocp>;  
//    __overlay__ { 
//	gpio_helper {
//		//compatible = "bone-pinmux-helper"; 
//	      status = "okay";  
//	      pinctrl-names = "default";  
//	      pinctrl-0 = <&gpio_pins>; 
//	      }; 
//    };  
//   };  
   
   // This enables the PRU and assigns the GPIO pins to it for use in EGP mode.  
   fragment@1 {  
    target = <&pruss>;  
    __overlay__ {  
      status = "okay";  
      pinctrl-names = "default";  
      pinctrl-0 = <&example_pins>;  
    };  
   }; 
};   
 
